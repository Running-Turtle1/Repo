#include "reg52.h"

/* data, RCLK 是预定义变量*/

int i, j, k = 0;
sbit SER = P3^4; // 串行数据输入引脚
sbit SRCLK = P3^6; // 移位时钟输入引脚
sbit RCLK_ = P3^5; // 存储时钟输入引脚

void delay_ten_us(int x){
	while(x --);
}

// 上升沿时数据寄存器的数据移位。Q0->Q1->Q2-->Q3-->...-->Q7;下降沿移位寄存器数据不变。
void SRCLK_down(){
	SRCLK = 0;
	delay_ten_us(1);
	SRCLK = 1;
	delay_ten_us(1);
}

// 12 脚 : 上升沿时移位寄存器的数据进入数据存储寄存器，下降沿时存储寄存器数据不变。
void RCLK_down(){
	RCLK_ = 0;
	delay_ten_us(1);
	RCLK_ = 1;
	delay_ten_us(1);
}

// 写入数据
void hc595_write_data(int data_){
	int i;
	for(i = 7; i >= 0; i --){
		SER = data_ >> i & 1;
		SRCLK_down();
	}		
	RCLK_down();
}
/*
01111111
10111111
11011111
11101111
11110111
11111011
11111101
11111110
*/
unsigned char code col[8] = {0x7f, 0xbf, 0xdf, 0xef, 0xf7, 0xfb, 0xfd, 0xfe};


unsigned char code led_matrix_row_codes[][8] = {
	{0x00,0x00,0x3e,0x41,0x41,0x41,0x3e,0x00},     //0
	{0x00,0x00,0x00,0x21,0x7f,0x01,0x00,0x00},     //1
	{0x00,0x00,0x27,0x45,0x45,0x45,0x39,0x00},     //2
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	{0x00,0x00,0x32,0x49,0x49,0x49,0x3e,0x00}, 	   //9
};
/*
	74HC595 控制行
	对于行, 1 是联通
	0x0f = 0000 1111
	从上到下后四个亮
*/
/*
	P0 控制列
	对于列, 0 是联通
	0x7f = 0111 1111
	从左到右控制列的从左到右
*/
void main(){
	P0 = 0xff;
	for(i = 0; i < 10; i ++){
		for(j = 0; j < 8; j ++){
			hc595_write_data(led_matrix_row_codes[i][j]);
			P0 = col[j];
			delay_ten_us(100);
			P0 = 0xff;
		}
		delay_ten_us(100 * 500);
		delay_ten_us(100 * 500);
		delay_ten_us(100 * 500);
	}
}