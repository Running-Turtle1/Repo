#include "public.h"

u8 code lcd1602_table[]="22-51-CLASS" ;
/**************************************************
函数名称：void lcd1602_busy_test()
函数功能：LCD1602是否BUSY检测
输入：
	DB7: 
		1 :表示“忙”
		0 :表示“闲”
输出：void
**************************************************/
void lcd1602_busy_test()
{
	//开始准备数据
	LCD1602_DATA_PORT=0xFF;
	//命令
	LCD1602_RS=0;
	//读操作
	LCD1602_RW=1;

	//读的过程
	LCD1602_E=1;
	while(LCD1602_DATA_PORT&0x80);
	LCD1602_E=0;	
}

/**************************************************
函数名称：void lcd1602_write_cmd(u8 cmd)
函数功能：向LCD1602写入命令
输入：u8 cmd
输出：void
**************************************************/
void lcd1602_write_cmd(u8 cmd)
{
	//命令
	LCD1602_RS=0;
	//写操作
	LCD1602_RW=0;
	//E为低电平，准备产生上升沿
	LCD1602_E=0;
	//开始准备数据
	LCD1602_DATA_PORT=cmd;
	//延时1ms
	//等待数据准备好
	delay_10us(100);

	//产生上升沿
	//开始数据传输
	LCD1602_E=1;
	//延时1ms
	//等待数据传输完成
	delay_10us(100);

	//产生下降沿
	//结束数据传输
	LCD1602_E=0;
}
/**************************************************
函数名称：void lcd1602_write_data(u8 dat)
函数功能：向LCD1602写入命令
输入：u8 dat
输出：void
**************************************************/
void lcd1602_write_data(u8 dat)
{
	//数据
	LCD1602_RS=1;
	//写操作
	LCD1602_RW=0;
	//E为低电平，产生上手沿后，开始向LCD上面的操作
	LCD1602_E=0;
	//开始准备数据
	LCD1602_DATA_PORT=dat;
	//延时1ms
	//等待数据准备好
	delay_10us(100);

	//产生上升沿
	//开始数据传输
	LCD1602_E=1;
	//延时1ms
	//等待数据传输完成
	delay_10us(100);

	//产生下降沿
	//结束数据传输
	LCD1602_E=0;
}

/**************************************************
函数名称：void lcd1602_init()
函数功能：向LCD1602写入命令
输入：u8 cmd
输出：void
**************************************************/
void lcd1602_init()
{
	//“0x38”命令表示数据总线为8位，显示两行，每个字符是5*7点阵;
	lcd1602_write_cmd(0x38);
	//“0x0C”命令表示开显示，关闭光标;
	lcd1602_write_cmd(0x0C);
	//'0x06”命令表示写字符后地址自动+1;
	lcd1602_write_cmd(0x06);
	//“0x01”命令表示清屏；
	lcd1602_write_cmd(0x01);
}

/**************************************************
函数名称：void lcd1602_clear(void)
函数功能：向LCD1602写入命令
输入：u8 cmd
输出：void
**************************************************/
void lcd1602_clear(void)
{
	lcd1602_write_cmd(0x01);	
}
/**************************************************
函数名称：void lcd1602_show_data(u8 x,u8 y,u8 dat)
函数功能：向LCD1602(x,y)写入字符 ‘dat’，并显示
输入：
	u8 x（0~15）；
	u8 y（0~1）；
	u8 data:LCD只能显示ASCII码，必须为字符
	例如：	数字 '0'~'9'
			字母 ‘a’~'Z'
			符号 '>'
输出：void
**************************************************/
void lcd1602_show_data(u8 x,u8 y,u8 dat)
{
	u8 addr;
	//参数有效检测
	if(x>15||y>1)
		return;

	//第1行
	if(y==0)
	{
		addr=0x00+x;
	}
	//第2行
	else
	{
		addr=0x40+x;		
	}
	lcd1602_write_cmd(addr|0x80);
	lcd1602_write_data(dat);	  
}
/**************************************************
函数名称：void lcd1602_show_string(u8 x,u8 y,u8 *str)
函数功能：向LCD1602(x,y)写入字符串*str，并显示
输入：
	u8 x（0~15）；
	u8 y（0~1）；
	u8 *str
输出：void
**************************************************/
void lcd1602_show_string(u8 x,u8 y,u8 *str)
{
	u8 addr=0;
	//参数有效检测
	if(x>15||y>1)
		return;

	//第1行
	if(y==0)
	{
		addr=0x00+x;
	}
	//第2行
	else
	{
		addr=0x40+x;		
	}
	lcd1602_write_cmd(addr|0x80);
	while(*str!='\0')
	{
		lcd1602_write_data(*str);
		str++;		
	}
}
